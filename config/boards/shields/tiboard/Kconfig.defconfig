## config/boards/shields/tiboard/Kconfig.defconfig
```kconfig
# Copyright (c) 2020 Ryan Cross
# SPDX-License-Identifier: MIT

if SHIELD_TIBOARD_RIGHT

config ZMK_KEYBOARD_NAME
	default "tiboard"

config ZMK_SPLIT_ROLE_CENTRAL
	default y
	
endif

if SHIELD_TIBOARD || SHIELD_TIBOARD_LEFT || SHIELD_TIBOARD_RIGHT

config ZMK_SPLIT
	default y

config BT_CTLR
	default BT

config ZMK_BLE
	default y

config ZMK_USB
	default y

if USB

config USB_NRFX
	default y

config USB_DEVICE_STACK
	default y

endif # USB

if ZMK_DISPLAY

config I2C
	default y

config SSD1306
	default y

config SSD1306_REVERSE_MODE
	default y

endif # ZMK_DISPLAY

if LVGL

config LV_Z_VDB_SIZE
	default 64

config LV_Z_DPI
	default 148

config LV_Z_BITS_PER_PIXEL
	default 1

choice LV_COLOR_DEPTH
	default LV_COLOR_DEPTH_1
endchoice

endif # LVGL

endif
```

## config/boards/shields/tiboard/Kconfig.shield
```kconfig
# Copyright (c) 2020 Ryan Cross
# SPDX-License-Identifier: MIT

config SHIELD_TIBOARD_LEFT
	def_bool $(shields_list_contains,tiboard_left)

config SHIELD_TIBOARD_RIGHT
	def_bool $(shields_list_contains,tiboard_right)

menuconfig WS2812_STRIP
	bool "WS2812 (and compatible) LED strip driver"
	select LED_STRIP_RGB_SCRATCH
	help
	  Enable LED strip driver for daisy chains of WS2812-ish (or WS2812B,
	  WS2813, SK6812, Everlight B1414, or compatible) devices.

choice WS2812_STRIP_DRIVER
	prompt "Driver backend"
	default WS2812_STRIP_SPI
	depends on WS2812_STRIP

config WS2812_STRIP_SPI
	bool "SPI driver"
	depends on SPI
	help
	  The SPI driver is portable, but requires significantly more
	  memory (1 byte of overhead per bit of pixel data).

config WS2812_STRIP_I2S
	bool "I2S driver"
	depends on I2S
	help
	  Uses the I2S peripheral, memory usage is 4 bytes per color,
	  times the number of pixels. A few more for the start and end
	  delay. The reset delay has a coarse resolution of ~20us.

config WS2812_STRIP_GPIO
	bool "GPIO driver"
	# Only an Cortex-M0 inline assembly implementation for the nRF51
	# is supported currently.
	depends on SOC_SERIES_NRF51X
	help
	  The GPIO driver does bit-banging with inline assembly,
	  and is not available on all SoCs.

	  Note that this driver is not compatible with the Everlight B1414
	  controller.

endchoice
```

## config/west.yml
```yaml
manifest:
  remotes:
    - name: zmkfirmware
      url-base: https://github.com/zmkfirmware
    - name: infused-kim
      url-base: https://github.com/infused-kim
projects:
    - name: zmk-zephyr
      remote: infused-kim
      revision: v2.5.0+zmk-fixes+kim-fixes
      clone-depth: 1
      import: app/west.yml
  self:
    path: config
```
